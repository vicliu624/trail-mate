## apps/esp_idf/targets/t_display_p4/sdkconfig.defaults
```kconfig
CONFIG_IDF_TARGET="esp32p4"
CONFIG_ESPTOOLPY_FLASHSIZE_16MB=y
CONFIG_PARTITION_TABLE_CUSTOM=y
CONFIG_PARTITION_TABLE_CUSTOM_FILENAME="partitions.csv"
CONFIG_SPIRAM=y
CONFIG_SPIRAM_MODE_HEX=y
CONFIG_SPIRAM_SPEED_200M=y
CONFIG_CACHE_L2_CACHE_256KB=y
CONFIG_CACHE_L2_CACHE_LINE_128B=y
CONFIG_ESPTOOLPY_FLASHFREQ_120M=y
CONFIG_IDF_EXPERIMENTAL_FEATURES=y
CONFIG_TINYUSB_MSC_ENABLED=y
```

## apps/esp_idf/targets/t_display_p4_amoled/sdkconfig.defaults
```kconfig
CONFIG_IDF_TARGET="esp32p4"
CONFIG_ESP32P4_SELECTS_REV_LESS_V3=y
CONFIG_ESP32P4_REV_MIN_100=y
CONFIG_ESPTOOLPY_FLASHSIZE_16MB=y
CONFIG_PARTITION_TABLE_CUSTOM=y
CONFIG_PARTITION_TABLE_CUSTOM_FILENAME="partitions.csv"
CONFIG_SPIRAM=y
CONFIG_SPIRAM_MODE_HEX=y
CONFIG_SPIRAM_SPEED_200M=y
CONFIG_CACHE_L2_CACHE_256KB=y
CONFIG_CACHE_L2_CACHE_LINE_128B=y
CONFIG_ESPTOOLPY_FLASHFREQ_120M=y
CONFIG_IDF_EXPERIMENTAL_FEATURES=y
CONFIG_TINYUSB_MSC_ENABLED=y
CONFIG_ESP_MAIN_TASK_STACK_SIZE=8192
CONFIG_ESP_TASK_WDT_TIMEOUT_S=20
CONFIG_TRAIL_MATE_T_DISPLAY_P4_PANEL_RM69A10=y
CONFIG_TRAIL_MATE_T_DISPLAY_P4_PIXEL_FORMAT_RGB565=y
CONFIG_TRAIL_MATE_T_DISPLAY_P4_LVGL_BUFFER_LINES=80
```

## apps/esp_idf/targets/tab5/sdkconfig.defaults
```kconfig
CONFIG_IDF_TARGET="esp32p4"
CONFIG_ESPTOOLPY_FLASHMODE_QIO=y
CONFIG_ESPTOOLPY_FLASHSIZE_16MB=y
CONFIG_PARTITION_TABLE_CUSTOM=y
CONFIG_PARTITION_TABLE_CUSTOM_FILENAME="partitions.csv"
CONFIG_COMPILER_OPTIMIZATION_PERF=y
CONFIG_SPIRAM=y
CONFIG_SPIRAM_MODE_HEX=y
CONFIG_SPIRAM_SPEED_200M=y
CONFIG_SPIRAM_XIP_FROM_PSRAM=y
CONFIG_CACHE_L2_CACHE_256KB=y
CONFIG_CACHE_L2_CACHE_LINE_128B=y
CONFIG_IDF_EXPERIMENTAL_FEATURES=y
CONFIG_TINYUSB_MSC_ENABLED=y
CONFIG_ESP_TASK_WDT_PANIC=y
CONFIG_TASK_WDT_PANIC=y
CONFIG_ESP_COREDUMP_ENABLE_TO_FLASH=y
```

## builds/esp_idf/targets/tlora_pager/sdkconfig.defaults
```kconfig
# Minimal ESP-IDF compile baseline derived from boards/lilygo-t-lora-pager.json.
# Hardware-specific PSRAM/display/NFC validation remains pending.
CONFIG_IDF_TARGET="esp32s3"
CONFIG_ESPTOOLPY_FLASHMODE_QIO=y
CONFIG_ESPTOOLPY_FLASHSIZE_16MB=y
CONFIG_PARTITION_TABLE_CUSTOM=y
CONFIG_PARTITION_TABLE_CUSTOM_FILENAME="partitions.csv"
CONFIG_ESP_MAIN_TASK_STACK_SIZE=8192
CONFIG_ESP_TASK_WDT_TIMEOUT_S=20
```
