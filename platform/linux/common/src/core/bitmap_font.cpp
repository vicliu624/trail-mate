#include "core/bitmap_font.h"

#include <algorithm>
#include <array>
#include <cctype>
#include <cstdint>

namespace trailmate::cardputer_zero::core::bitmap_font
{
namespace
{

struct Glyph
{
    std::array<std::uint8_t, kGlyphHeight> rows{};
};

Glyph glyphFor(char raw) noexcept
{
    switch (raw)
    {
    case 'a':
        return Glyph{{0x00, 0x00, 0x0E, 0x01, 0x0F, 0x11, 0x0F}};
    case 'b':
        return Glyph{{0x10, 0x10, 0x1E, 0x11, 0x11, 0x11, 0x1E}};
    case 'c':
        return Glyph{{0x00, 0x00, 0x0E, 0x11, 0x10, 0x11, 0x0E}};
    case 'd':
        return Glyph{{0x01, 0x01, 0x0F, 0x11, 0x11, 0x11, 0x0F}};
    case 'e':
        return Glyph{{0x00, 0x00, 0x0E, 0x11, 0x1F, 0x10, 0x0E}};
    case 'f':
        return Glyph{{0x06, 0x08, 0x1E, 0x08, 0x08, 0x08, 0x08}};
    case 'k':
        return Glyph{{0x10, 0x10, 0x12, 0x14, 0x18, 0x14, 0x12}};
    case 'l':
        return Glyph{{0x0C, 0x04, 0x04, 0x04, 0x04, 0x04, 0x0E}};
    case 'n':
        return Glyph{{0x00, 0x00, 0x1E, 0x11, 0x11, 0x11, 0x11}};
    case 'o':
        return Glyph{{0x00, 0x00, 0x0E, 0x11, 0x11, 0x11, 0x0E}};
    case 'r':
        return Glyph{{0x00, 0x00, 0x16, 0x19, 0x10, 0x10, 0x10}};
    case 't':
        return Glyph{{0x08, 0x08, 0x1E, 0x08, 0x08, 0x09, 0x06}};
    default:
        break;
    }

    const char ch = static_cast<char>(std::toupper(static_cast<unsigned char>(raw)));

    switch (ch)
    {
    case 'A':
        return Glyph{{0x0E, 0x11, 0x11, 0x1F, 0x11, 0x11, 0x11}};
    case 'B':
        return Glyph{{0x1E, 0x11, 0x11, 0x1E, 0x11, 0x11, 0x1E}};
    case 'C':
        return Glyph{{0x0E, 0x11, 0x10, 0x10, 0x10, 0x11, 0x0E}};
    case 'D':
        return Glyph{{0x1E, 0x11, 0x11, 0x11, 0x11, 0x11, 0x1E}};
    case 'E':
        return Glyph{{0x1F, 0x10, 0x10, 0x1E, 0x10, 0x10, 0x1F}};
    case 'F':
        return Glyph{{0x1F, 0x10, 0x10, 0x1E, 0x10, 0x10, 0x10}};
    case 'G':
        return Glyph{{0x0E, 0x11, 0x10, 0x17, 0x11, 0x11, 0x0E}};
    case 'H':
        return Glyph{{0x11, 0x11, 0x11, 0x1F, 0x11, 0x11, 0x11}};
    case 'I':
        return Glyph{{0x1F, 0x04, 0x04, 0x04, 0x04, 0x04, 0x1F}};
    case 'J':
        return Glyph{{0x01, 0x01, 0x01, 0x01, 0x11, 0x11, 0x0E}};
    case 'K':
        return Glyph{{0x11, 0x12, 0x14, 0x18, 0x14, 0x12, 0x11}};
    case 'L':
        return Glyph{{0x10, 0x10, 0x10, 0x10, 0x10, 0x10, 0x1F}};
    case 'M':
        return Glyph{{0x11, 0x1B, 0x15, 0x15, 0x11, 0x11, 0x11}};
    case 'N':
        return Glyph{{0x11, 0x19, 0x15, 0x13, 0x11, 0x11, 0x11}};
    case 'O':
        return Glyph{{0x0E, 0x11, 0x11, 0x11, 0x11, 0x11, 0x0E}};
    case 'P':
        return Glyph{{0x1E, 0x11, 0x11, 0x1E, 0x10, 0x10, 0x10}};
    case 'Q':
        return Glyph{{0x0E, 0x11, 0x11, 0x11, 0x15, 0x12, 0x0D}};
    case 'R':
        return Glyph{{0x1E, 0x11, 0x11, 0x1E, 0x14, 0x12, 0x11}};
    case 'S':
        return Glyph{{0x0F, 0x10, 0x10, 0x0E, 0x01, 0x01, 0x1E}};
    case 'T':
        return Glyph{{0x1F, 0x04, 0x04, 0x04, 0x04, 0x04, 0x04}};
    case 'U':
        return Glyph{{0x11, 0x11, 0x11, 0x11, 0x11, 0x11, 0x0E}};
    case 'V':
        return Glyph{{0x11, 0x11, 0x11, 0x11, 0x11, 0x0A, 0x04}};
    case 'W':
        return Glyph{{0x11, 0x11, 0x11, 0x15, 0x15, 0x15, 0x0A}};
    case 'X':
        return Glyph{{0x11, 0x11, 0x0A, 0x04, 0x0A, 0x11, 0x11}};
    case 'Y':
        return Glyph{{0x11, 0x11, 0x0A, 0x04, 0x04, 0x04, 0x04}};
    case 'Z':
        return Glyph{{0x1F, 0x01, 0x02, 0x04, 0x08, 0x10, 0x1F}};
    case '0':
        return Glyph{{0x0E, 0x11, 0x13, 0x15, 0x19, 0x11, 0x0E}};
    case '1':
        return Glyph{{0x04, 0x0C, 0x04, 0x04, 0x04, 0x04, 0x0E}};
    case '2':
        return Glyph{{0x0E, 0x11, 0x01, 0x02, 0x04, 0x08, 0x1F}};
    case '3':
        return Glyph{{0x1F, 0x02, 0x04, 0x02, 0x01, 0x11, 0x0E}};
    case '4':
        return Glyph{{0x02, 0x06, 0x0A, 0x12, 0x1F, 0x02, 0x02}};
    case '5':
        return Glyph{{0x1F, 0x10, 0x1E, 0x01, 0x01, 0x11, 0x0E}};
    case '6':
        return Glyph{{0x06, 0x08, 0x10, 0x1E, 0x11, 0x11, 0x0E}};
    case '7':
        return Glyph{{0x1F, 0x01, 0x02, 0x04, 0x08, 0x08, 0x08}};
    case '8':
        return Glyph{{0x0E, 0x11, 0x11, 0x0E, 0x11, 0x11, 0x0E}};
    case '9':
        return Glyph{{0x0E, 0x11, 0x11, 0x0F, 0x01, 0x02, 0x0C}};
    case '#':
        return Glyph{{0x0A, 0x0A, 0x1F, 0x0A, 0x1F, 0x0A, 0x0A}};
    case '$':
        return Glyph{{0x04, 0x0F, 0x14, 0x0E, 0x05, 0x1E, 0x04}};
    case '%':
        return Glyph{{0x19, 0x19, 0x02, 0x04, 0x08, 0x13, 0x13}};
    case '&':
        return Glyph{{0x0C, 0x12, 0x14, 0x08, 0x15, 0x12, 0x0D}};
    case '\'':
        return Glyph{{0x04, 0x04, 0x02, 0x00, 0x00, 0x00, 0x00}};
    case '(':
        return Glyph{{0x02, 0x04, 0x08, 0x08, 0x08, 0x04, 0x02}};
    case ')':
        return Glyph{{0x08, 0x04, 0x02, 0x02, 0x02, 0x04, 0x08}};
    case '*':
        return Glyph{{0x00, 0x15, 0x0E, 0x1F, 0x0E, 0x15, 0x00}};
    case '+':
        return Glyph{{0x00, 0x04, 0x04, 0x1F, 0x04, 0x04, 0x00}};
    case '-':
        return Glyph{{0x00, 0x00, 0x00, 0x1F, 0x00, 0x00, 0x00}};
    case ',':
        return Glyph{{0x00, 0x00, 0x00, 0x00, 0x0C, 0x0C, 0x08}};
    case '.':
        return Glyph{{0x00, 0x00, 0x00, 0x00, 0x00, 0x0C, 0x0C}};
    case ':':
        return Glyph{{0x00, 0x0C, 0x0C, 0x00, 0x0C, 0x0C, 0x00}};
    case ';':
        return Glyph{{0x00, 0x0C, 0x0C, 0x00, 0x0C, 0x0C, 0x08}};
    case '<':
        return Glyph{{0x01, 0x02, 0x04, 0x08, 0x04, 0x02, 0x01}};
    case '=':
        return Glyph{{0x00, 0x00, 0x1F, 0x00, 0x1F, 0x00, 0x00}};
    case '>':
        return Glyph{{0x10, 0x08, 0x04, 0x02, 0x04, 0x08, 0x10}};
    case '?':
        return Glyph{{0x0E, 0x11, 0x01, 0x02, 0x04, 0x00, 0x04}};
    case '@':
        return Glyph{{0x0E, 0x11, 0x15, 0x17, 0x10, 0x11, 0x0E}};
    case '[':
        return Glyph{{0x0E, 0x08, 0x08, 0x08, 0x08, 0x08, 0x0E}};
    case '\\':
        return Glyph{{0x10, 0x08, 0x08, 0x04, 0x02, 0x02, 0x01}};
    case ']':
        return Glyph{{0x0E, 0x02, 0x02, 0x02, 0x02, 0x02, 0x0E}};
    case '^':
        return Glyph{{0x04, 0x0A, 0x11, 0x00, 0x00, 0x00, 0x00}};
    case '_':
        return Glyph{{0x00, 0x00, 0x00, 0x00, 0x00, 0x00, 0x1F}};
    case '`':
        return Glyph{{0x08, 0x04, 0x00, 0x00, 0x00, 0x00, 0x00}};
    case '/':
        return Glyph{{0x01, 0x02, 0x02, 0x04, 0x08, 0x08, 0x10}};
    case '!':
        return Glyph{{0x04, 0x04, 0x04, 0x04, 0x04, 0x00, 0x04}};
    case '"':
        return Glyph{{0x0A, 0x0A, 0x05, 0x00, 0x00, 0x00, 0x00}};
    case '{':
        return Glyph{{0x02, 0x04, 0x04, 0x08, 0x04, 0x04, 0x02}};
    case '|':
        return Glyph{{0x04, 0x04, 0x04, 0x04, 0x04, 0x04, 0x04}};
    case '}':
        return Glyph{{0x08, 0x04, 0x04, 0x02, 0x04, 0x04, 0x08}};
    case ' ':
        return Glyph{{0x00, 0x00, 0x00, 0x00, 0x00, 0x00, 0x00}};
    default:
        return Glyph{{0x1F, 0x01, 0x02, 0x04, 0x08, 0x00, 0x08}};
    }
}

void drawGlyph(Canvas& canvas, const Glyph& glyph, int x, int y, Color color, int scale) noexcept
{
    const int clamped_scale = std::max(scale, 1);

    for (int row = 0; row < kGlyphHeight; ++row)
    {
        for (int col = 0; col < kGlyphWidth; ++col)
        {
            const bool filled = ((glyph.rows[static_cast<std::size_t>(row)] >> (kGlyphWidth - 1 - col)) & 0x01U) != 0U;
            if (!filled)
            {
                continue;
            }

            for (int dy = 0; dy < clamped_scale; ++dy)
            {
                for (int dx = 0; dx < clamped_scale; ++dx)
                {
                    canvas.setPixel(x + (col * clamped_scale) + dx, y + (row * clamped_scale) + dy, color);
                }
            }
        }
    }
}

} // namespace

int measureText(std::string_view text, int scale) noexcept
{
    const int clamped_scale = std::max(scale, 1);
    int line_width = 0;
    int max_width = 0;

    for (const char ch : text)
    {
        if (ch == '\n')
        {
            max_width = std::max(max_width, line_width);
            line_width = 0;
            continue;
        }

        line_width += (kGlyphWidth + kGlyphSpacing) * clamped_scale;
    }

    max_width = std::max(max_width, line_width);
    return max_width > 0 ? max_width - (kGlyphSpacing * clamped_scale) : 0;
}

int lineHeight(int scale) noexcept
{
    const int clamped_scale = std::max(scale, 1);
    return (kGlyphHeight + 2) * clamped_scale;
}

void drawText(Canvas& canvas, std::string_view text, int x, int y, Color color, int scale) noexcept
{
    const int clamped_scale = std::max(scale, 1);
    int cursor_x = x;
    int cursor_y = y;

    for (const char ch : text)
    {
        if (ch == '\n')
        {
            cursor_x = x;
            cursor_y += lineHeight(clamped_scale);
            continue;
        }

        drawGlyph(canvas, glyphFor(ch), cursor_x, cursor_y, color, clamped_scale);
        cursor_x += (kGlyphWidth + kGlyphSpacing) * clamped_scale;
    }
}

} // namespace trailmate::cardputer_zero::core::bitmap_font
